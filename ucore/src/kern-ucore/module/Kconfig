## ucore/src/kern-ucore/module/Kconfig
```kconfig
menu "Linux Device Driver Environment"

config HAVE_LINUX_DDE_BASE
	bool "Enable Linux DDE base"
	default y
	help
		Enable Linux DDE base

config DDE_GOLDFISH_FB
  depends ARM_BOARD_GOLDFISH
  depends HAVE_LINUX_DDE_BASE
  bool "Enable Goldfish Framebuffer"
  default n

config DDE_GOLDFISH_EVENT
  depends ARM_BOARD_GOLDFISH
  depends HAVE_LINUX_DDE_BASE
  bool "Enable Goldfish Event Input"
  default n

config DDE_EXAMPLE_CHRDEV
  depends HAVE_LINUX_DDE_BASE
  bool "Enable Example Chrdev"
  default n

endmenu
```
